#include "actuators.h"
#include <stdio.h>
#include <string.h>
#include "freertos/FreeRTOS.h"
#include "freertos/task.h"
#include "driver/gpio.h"
#include "driver/i2c.h"
#include "esp_adc/adc_oneshot.h"
#include "esp_log.h"
#include "app_config.h"

static const char *TAG = "ACTUATORS";

/* --------------------------------------------------------------------------
 * 1. DEFINICIONES HARDWARE DEL ENTRENADOR SBC
 * -------------------------------------------------------------------------- */
// Sensor LDR: GPIO 34 (ADC1 CH6)
#define LDR_ADC_UNIT            ADC_UNIT_1
#define LDR_ADC_CHANNEL         ADC_CHANNEL_6

// Bus I2C - OLED SSD1306
#define OLED_I2C_PORT           I2C_NUM_0
#define OLED_PIN_SDA            GPIO_NUM_21
#define OLED_PIN_SCL            GPIO_NUM_22
#define OLED_I2C_ADDR           0x3C

// Display 7 Segmentos: Ánodo Común 5161BS (Pines A -> G)
#define SEG_A_PIN               GPIO_NUM_13
#define SEG_B_PIN               GPIO_NUM_12
#define SEG_C_PIN               GPIO_NUM_14
#define SEG_D_PIN               GPIO_NUM_27
#define SEG_E_PIN               GPIO_NUM_26
#define SEG_F_PIN               GPIO_NUM_25
#define SEG_G_PIN               GPIO_NUM_33

#define DISPLAY_GPIO_MASK       ((1ULL << SEG_A_PIN) | (1ULL << SEG_B_PIN) | \
                                 (1ULL << SEG_C_PIN) | (1ULL << SEG_D_PIN) | \
                                 (1ULL << SEG_E_PIN) | (1ULL << SEG_F_PIN) | \
                                 (1ULL << SEG_G_PIN))

static const gpio_num_t s_seg_pins[7] = {
    SEG_A_PIN, SEG_B_PIN, SEG_C_PIN, SEG_D_PIN, SEG_E_PIN, SEG_F_PIN, SEG_G_PIN
};

// Tabla de segmentos activa (1 = encendido). En Ánodo Común se polariza a 0V (active-low)
static const uint8_t s_digit_map[10] = {
    0b00111111, // 0
    0b00000110, // 1
    0b01011011, // 2
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    0b01111111, // 8
    0b01101111  // 9
};

/* --------------------------------------------------------------------------
 * 2. FUENTE TIPOGRÁFICA 8x8 (ASCII 32 a 126)
 * -------------------------------------------------------------------------- */
static const uint8_t s_font8x8[96][8] = {
    {0x00,0x00,0x00,0x00,0x00,0x00,0x00,0x00}, // 32 ' '
    {0x18,0x3C,0x3C,0x18,0x18,0x00,0x18,0x00}, // 33 '!'
    {0x66,0x66,0x24,0x00,0x00,0x00,0x00,0x00}, // 34 '"'
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    {0x76,0xDC,0x00,0x00,0x00,0x00,0x00,0x00}  // 126 '~'
};

/* --------------------------------------------------------------------------
 * 3. CONTROLADOR SSD1306 NATIVO (128x64 I2C)
 * -------------------------------------------------------------------------- */
static uint8_t s_oled_buffer[1024]; // 128x64 bits = 1024 bytes (8 páginas)
static bool s_oled_ready = false;
static int  s_light_level = 0;
static adc_oneshot_unit_handle_t s_adc_handle = NULL;

static esp_err_t oled_send_cmd(uint8_t cmd)
{
    i2c_cmd_handle_t handle = i2c_cmd_link_create();
    i2c_master_start(handle);
    i2c_master_write_byte(handle, (OLED_I2C_ADDR << 1) | I2C_MASTER_WRITE, true);
    i2c_master_write_byte(handle, 0x00, true); // Control byte: Command
    i2c_master_write_byte(handle, cmd, true);
    i2c_master_stop(handle);
    esp_err_t ret = i2c_master_cmd_begin(OLED_I2C_PORT, handle, pdMS_TO_TICKS(50));
    i2c_cmd_link_delete(handle);
    return ret;
}

static void oled_flush(void)
{
    if (!s_oled_ready) return;
    for (uint8_t page = 0; page < 8; page++) {
        oled_send_cmd(0xB0 + page); // Set Page Start Address
        oled_send_cmd(0x00);        // Lower Column
        oled_send_cmd(0x10);        // Higher Column

        i2c_cmd_handle_t handle = i2c_cmd_link_create();
        i2c_master_start(handle);
        i2c_master_write_byte(handle, (OLED_I2C_ADDR << 1) | I2C_MASTER_WRITE, true);
        i2c_master_write_byte(handle, 0x40, true); // Control byte: Data
        i2c_master_write(handle, &s_oled_buffer[page * 128], 128, true);
        i2c_master_stop(handle);
        i2c_master_cmd_begin(OLED_I2C_PORT, handle, pdMS_TO_TICKS(50));
        i2c_cmd_link_delete(handle);
    }
}

static void oled_clear(void)
{
    memset(s_oled_buffer, 0, sizeof(s_oled_buffer));
}

static void oled_draw_char(int x, int page, char c)
{
    if (c < 32 || c > 126 || page >= 8 || x > 120) return;
    const uint8_t *glyph = s_font8x8[c - 32];
    for (int col = 0; col < 8; col++) {
        uint8_t bits = 0;
        for (int row = 0; row < 8; row++) {
            if ((glyph[row] >> (7 - col)) & 0x01) {
                bits |= (1 << row);
            }
        }
        if (x + col < 128) {
            s_oled_buffer[page * 128 + x + col] = bits;
        }
    }
}

static void oled_draw_string(int x, int page, const char *str)
{
    int cur_x = x;
    while (*str && cur_x < 120) {
        oled_draw_char(cur_x, page, *str);
        cur_x += 8;
        str++;
    }
}

/* --------------------------------------------------------------------------
 * 4. IMPLEMENTACIÓN PÚBLICA DE ACTUADORES
 * -------------------------------------------------------------------------- */
void actuators_set_7seg_digit(int digit)
{
    // Ánodo Común: Nivel 1 (3.3V) apaga el segmento; Nivel 0 (0V) lo enciende
    if (digit < 0 || digit > 9) {
        for (int i = 0; i < 7; i++) {
            gpio_set_level(s_seg_pins[i], 1);
        }
        return;
    }

    uint8_t mask = s_digit_map[digit];
    for (int i = 0; i < 7; i++) {
        int bit_active = (mask >> i) & 0x01;
        gpio_set_level(s_seg_pins[i], bit_active ? 0 : 1);
    }
}

void actuators_update_oled(const char *version, const char *partition, const char *status)
{
    if (!s_oled_ready) return;

    oled_clear();
    oled_draw_string(0, 0, "HITO 6 - SBC26T06");
    
    char buf[20];
    snprintf(buf, sizeof(buf), "FW:   v%s", version ? version : "?");
    oled_draw_string(0, 2, buf);

    snprintf(buf, sizeof(buf), "SLOT: %s", partition ? partition : "?");
    oled_draw_string(0, 4, buf);

    snprintf(buf, sizeof(buf), "EST:  %s", status ? status : "NORMAL");
    oled_draw_string(0, 6, buf);

    oled_flush();
}

void actuators_update_ota_progress(int percent, int kb_received)
{
    if (!s_oled_ready) return;

    oled_clear();
    oled_draw_string(0, 0, "ACTUALIZANDO OTA");
    
    char buf[20];
    snprintf(buf, sizeof(buf), "Recib: %d KB", kb_received);
    oled_draw_string(0, 2, buf);

    snprintf(buf, sizeof(buf), "Progreso: %d%%", percent);
    oled_draw_string(0, 4, buf);

    // Barra gráfica dinámica (Línea 6-7)
    int width = (percent * 120) / 100;
    if (width > 120) width = 120;
    for (int x = 4; x < 4 + width; x++) {
        s_oled_buffer[6 * 128 + x] |= 0xFF;
        s_oled_buffer[7 * 128 + x] |= 0xFF;
    }

    oled_flush();
}

int actuators_get_light_level(void)
{
    return s_light_level;
}

/* --------------------------------------------------------------------------
 * 5. TAREA SENSORIAL EN SEGUNDO PLANO (LDR)
 * -------------------------------------------------------------------------- */
static void ldr_task(void *pvParameters)
{
    int raw = 0;
    while (1) {
        if (s_adc_handle != NULL) {
            if (adc_oneshot_read(s_adc_handle, LDR_ADC_CHANNEL, &raw) == ESP_OK) {
                // Mapeo lineal simple a escala 0-9 para el display
                s_light_level = (raw * 10) / 4095;
                if (s_light_level > 9) s_light_level = 9;
            }
        }
        vTaskDelay(pdMS_TO_TICKS(1000));
    }
}

esp_err_t actuators_init(void)
{
    ESP_LOGI(TAG, "Configurando hardware local (7-Segmentos, OLED I2C y LDR)...");

    // 1. Inicializar pines 7 segmentos
    gpio_config_t seg_conf = {
        .pin_bit_mask = DISPLAY_GPIO_MASK,
        .mode = GPIO_MODE_OUTPUT,
        .pull_down_en = GPIO_PULLDOWN_DISABLE,
        .pull_up_en = GPIO_PULLUP_DISABLE,
        .intr_type = GPIO_INTR_DISABLE,
    };
    ESP_ERROR_CHECK(gpio_config(&seg_conf));
    actuators_set_7seg_digit(-1); // Apagar inicialmente

    // 2. Inicializar bus I2C para pantalla OLED
    i2c_config_t i2c_conf = {
        .mode = I2C_MODE_MASTER,
        .sda_io_num = OLED_PIN_SDA,
        .scl_io_num = OLED_PIN_SCL,
        .sda_pullup_en = GPIO_PULLUP_ENABLE,
        .scl_pullup_en = GPIO_PULLUP_ENABLE,
        .master.clk_speed = 400000,
    };
    i2c_param_config(OLED_I2C_PORT, &i2c_conf);
    i2c_driver_install(OLED_I2C_PORT, i2c_conf.mode, 0, 0, 0);

    // Secuencia de inicialización SSD1306 (128x64)
    const uint8_t init_cmds[] = {
        0xAE, 0xD5, 0x80, 0xA8, 0x3F, 0xD3, 0x00, 0x40,
        0x8D, 0x14, 0x20, 0x02, 0xA1, 0xC8, 0xDA, 0x12,
        0x81, 0xCF, 0xD9, 0xF1, 0xDB, 0x40, 0xA4, 0xA6, 0xAF
    };
    for (size_t i = 0; i < sizeof(init_cmds); i++) {
        oled_send_cmd(init_cmds[i]);
    }
    s_oled_ready = true;
    oled_clear();
    oled_draw_string(0, 0, "HITO 6 - SBC26T06");
    oled_draw_string(0, 2, "INICIANDO...");
    oled_flush();

    // 3. Inicializar ADC para LDR
    adc_oneshot_unit_init_cfg_t adc_init_cfg = {
        .unit_id = LDR_ADC_UNIT,
        .ulp_mode = ADC_ULP_MODE_DISABLE,
    };
    if (adc_oneshot_new_unit(&adc_init_cfg, &s_adc_handle) == ESP_OK) {
        adc_oneshot_chan_cfg_t chan_cfg = {
            .atten = ADC_ATTEN_DB_12,
            .bitwidth = ADC_BITWIDTH_DEFAULT,
        };
        adc_oneshot_config_channel(s_adc_handle, LDR_ADC_CHANNEL, &chan_cfg);
        xTaskCreate(ldr_task, "ldr_task", 2048, NULL, 3, NULL);
    }

    ESP_LOGI(TAG, "Hardware local inicializado correctamente.");
    return ESP_OK;
}
